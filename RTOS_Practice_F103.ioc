# file: RTOS_Practice_F103.ioc
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FREERTOS.BinarySemaphores01=buttonEventSemaphore,Dynamic,NULL,Depleted
FREERTOS.Events01=systemEventFlags,Dynamic,NULL
FREERTOS.Mutexes01=systemDataMutex,Dynamic,NULL,Available
FREERTOS.Queues01=statusQueue,16,uint32_t,0,Dynamic,NULL,NULL
FREERTOS.Tasks01=ControlTask,32,128,StartControlTask,Default,NULL,Dynamic,NULL,NULL;DiagnosticTask,8,128,StartDiagnosticTask,Default,NULL,Dynamic,NULL,NULL;EventTask,24,128,StartEventTask,Default,NULL,Dynamic,NULL,NULL;MonitorTask,24,128,StartMonitorTask,Default,NULL,Dynamic,NULL,NULL
FREERTOS.Timers01=buttonDebounceTimer,ButtonDebounceTimerCallback,osTimerOnce,Default,NULL,Dynamic,NULL
FREERTOS.configCHECK_FOR_STACK_OVERFLOW=2
FREERTOS.configTOTAL_HEAP_SIZE=8192
FREERTOS.configUSE_MALLOC_FAILED_HOOK=1
FREERTOS.configUSE_NEWLIB_REENTRANT=1
Mcu.Family=STM32F1
Mcu.Name=STM32F103R(8-B)Tx
Mcu.Package=LQFP64
NVIC.EXTI0_IRQn=true\:5\:0\:false\:false\:true\:true\:true\:true\:true
NVIC.PriorityGroup=NVIC_PRIORITYGROUP_4
NVIC.TIM2_IRQn=true\:15\:0\:false\:false\:true\:false\:false\:true\:true
NVIC.TimeBase=TIM2_IRQn
NVIC.TimeBaseIP=TIM2
PA0-WKUP.GPIO_Label=BUTTON_INT
PA0-WKUP.GPIO_PuPd=GPIO_PULLDOWN
PA0-WKUP.Signal=GPXTI0
PA13.Mode=Serial_Wire
PA13.Signal=SYS_JTMS-SWDIO
PA14.Mode=Serial_Wire
PA14.Signal=SYS_JTCK-SWCLK
ProjectManager.HeapSize=0x200
ProjectManager.StackSize=0x400
ProjectManager.TargetToolchain=STM32CubeIDE
RCC.APB1Freq_Value=8000000
RCC.APB2Freq_Value=8000000
VP_FREERTOS_VS_CMSIS_V2.Mode=CMSIS_V2
VP_SYS_VS_tim2.Mode=TIM2
board=custom

// file: Core/Src/main.c
/* USER CODE BEGIN Header */
/**
  ******************************************************************************
  * @file           : main.c
  * @brief          : Main program body
  ******************************************************************************
  * @attention
  *
  * Copyright (c) 2026 STMicroelectronics.
  * All rights reserved.
  *
  * This software is licensed under terms that can be found in the LICENSE file
  * in the root directory of this software component.
  * If no LICENSE file comes with this software, it is provided AS-IS.
  *
  ******************************************************************************
  */
/* USER CODE END Header */
#include "main.h"
#include "cmsis_os.h"
#include "task_supervisor.h"

/* USER CODE BEGIN Includes */
#include "watchdog_policy.h"
#include "watchdog_service.h"
/* USER CODE END Includes */

/* USER CODE BEGIN PTD */
typedef struct
{
  uint32_t produced_count;
  uint32_t consumed_count;
  uint32_t last_status;
  uint32_t total_access_count;
} SystemData_t;

typedef struct
{
  volatile uint32_t request_count;
} WatchdogRequestContext_t;
/* USER CODE END PTD */

/* USER CODE BEGIN PD */
#define CONTROL_TASK_PERIOD_TICKS      10U
#define DIAGNOSTIC_TASK_PERIOD_TICKS  100U
#define EVENT_CONTROL_CYCLE_DONE     (1UL << 0)
#define EVENT_DIAGNOSTIC_CYCLE_DONE  (1UL << 1)
#define MONITOR_TIMEOUT_TICKS  200U
#define EVENT_ALL_CYCLES_DONE \
  (EVENT_CONTROL_CYCLE_DONE | EVENT_DIAGNOSTIC_CYCLE_DONE)
#define BUTTON_DEBOUNCE_TICKS 50U
/* USER CODE END PD */

/* Definitions for ControlTask */
osThreadId_t ControlTaskHandle;
const osThreadAttr_t ControlTask_attributes = {
  .name = "ControlTask",
  .stack_size = 128 * 4,
  .priority = (osPriority_t) osPriorityAboveNormal,
};
/* Definitions for DiagnosticTask */
osThreadId_t DiagnosticTaskHandle;
const osThreadAttr_t DiagnosticTask_attributes = {
  .name = "DiagnosticTask",
  .stack_size = 128 * 4,
  .priority = (osPriority_t) osPriorityLow,
};
/* Definitions for EventTask */
osThreadId_t EventTaskHandle;
const osThreadAttr_t EventTask_attributes = {
  .name = "EventTask",
  .stack_size = 128 * 4,
  .priority = (osPriority_t) osPriorityNormal,
};
/* Definitions for MonitorTask */
osThreadId_t MonitorTaskHandle;
const osThreadAttr_t MonitorTask_attributes = {
  .name = "MonitorTask",
  .stack_size = 128 * 4,
  .priority = (osPriority_t) osPriorityNormal,
};
/* Definitions for statusQueue */
osMessageQueueId_t statusQueueHandle;
const osMessageQueueAttr_t statusQueue_attributes = {
  .name = "statusQueue"
};
/* Definitions for buttonDebounceTimer */
osTimerId_t buttonDebounceTimerHandle;
const osTimerAttr_t buttonDebounceTimer_attributes = {
  .name = "buttonDebounceTimer"
};
/* Definitions for systemDataMutex */
osMutexId_t systemDataMutexHandle;
const osMutexAttr_t systemDataMutex_attributes = {
  .name = "systemDataMutex"
};
/* Definitions for buttonEventSemaphore */
osSemaphoreId_t buttonEventSemaphoreHandle;
const osSemaphoreAttr_t buttonEventSemaphore_attributes = {
  .name = "buttonEventSemaphore"
};
/* Definitions for systemEventFlags */
osEventFlagsId_t systemEventFlagsHandle;
const osEventFlagsAttr_t systemEventFlags_attributes = {
  .name = "systemEventFlags"
};
/* USER CODE BEGIN PV */
static volatile uint32_t control_task_run_count = 0U;
static volatile uint32_t diagnostic_task_run_count = 0U;
static volatile uint32_t queue_send_error_count = 0U;
static volatile uint32_t diagnostic_message_count = 0U;
static volatile uint32_t diagnostic_last_status = 0U;
static SystemData_t system_data = {0};
//static volatile uint32_t shared_counter = 0U;
static volatile uint32_t control_mutex_timeout_count = 0U;
static volatile uint32_t diagnostic_mutex_timeout_count = 0U;
static volatile uint32_t button_event_count = 0U;
static volatile uint32_t button_isr_count = 0U;
static volatile uint32_t button_semaphore_release_error_count = 0U;
//static volatile uint32_t monitor_sync_count = 0U;
static volatile uint32_t monitor_wait_error_count = 0U;
//static volatile uint32_t task_watchdog_fault_active = 0U;
//static volatile uint32_t task_watchdog_timeout_count = 0U;
static volatile uint32_t task_watchdog_last_error = 0U;
static WatchdogRequestContext_t watchdog_request_context =
{
  .request_count = 0U
};
static volatile uint32_t control_stack_min_free_bytes =0U;
static volatile uint32_t diagnostic_stack_min_free_bytes = 0U;
static volatile uint32_t event_stack_min_free_bytes =0U;
static volatile uint32_t monitor_stack_min_free_bytes =0U;
static volatile uint32_t button_timer_start_error_count =0U;
static volatile uint32_t button_debounced_count = 0U;
static volatile uint32_t button_bounce_rejected_count = 0U;
static TaskSupervisor_t task_supervisor;

/* USER CODE END PV */

void SystemClock_Config(void);
static void MX_GPIO_Init(void);
void StartControlTask(void *argument);
void StartDiagnosticTask(void *argument);
void StartEventTask(void *argument);
void StartMonitorTask(void *argument);
void ButtonDebounceTimerCallback(void *argument);

/* USER CODE BEGIN PFP */
void SystemClock_Config(void);
static void WatchdogRefresh_Request(void *context);
/* USER CODE END PFP */

/* USER CODE BEGIN 0 */
static void WatchdogRefresh_Request(void *context)
{
  WatchdogRequestContext_t *request_context =
      (WatchdogRequestContext_t *)context;

  request_context->request_count++;
}
/* USER CODE END 0 */

int main(void)
{

  /* MCU Configuration--------------------------------------------------------*/

  /* Reset of all peripherals, Initializes the Flash interface and the Systick. */
  HAL_Init();

  /* Configure the system clock */
  SystemClock_Config();

  /* USER CODE BEGIN SysInit */
  SCB->CCR |= SCB_CCR_DIV_0_TRP_Msk;
  SCB->CCR |= SCB_CCR_UNALIGN_TRP_Msk;
  /* USER CODE END SysInit */

  /* Initialize all configured peripherals */
  MX_GPIO_Init();
  /* USER CODE BEGIN 2 */
  if (TaskSupervisor_Init(&task_supervisor) !=
      TASK_SUPERVISOR_OK)
  {
    Error_Handler();
  }
  /* USER CODE END 2 */

  /* Init scheduler */
  osKernelInitialize();
  /* Create the mutex(es) */
  /* creation of systemDataMutex */
  systemDataMutexHandle = osMutexNew(&systemDataMutex_attributes);

  /* Create the semaphores(s) */
  /* creation of buttonEventSemaphore */
  buttonEventSemaphoreHandle = osSemaphoreNew(1, 0, &buttonEventSemaphore_attributes);

  /* Create the timer(s) */
  /* creation of buttonDebounceTimer */
  buttonDebounceTimerHandle = osTimerNew(ButtonDebounceTimerCallback, osTimerOnce, NULL, &buttonDebounceTimer_attributes);

  /* Create the queue(s) */
  /* creation of statusQueue */
  statusQueueHandle = osMessageQueueNew (16, sizeof(uint32_t), &statusQueue_attributes);

  /* Create the thread(s) */
  /* creation of ControlTask */
  ControlTaskHandle = osThreadNew(StartControlTask, NULL, &ControlTask_attributes);

  /* creation of DiagnosticTask */
  DiagnosticTaskHandle = osThreadNew(StartDiagnosticTask, NULL, &DiagnosticTask_attributes);

  /* creation of EventTask */
  EventTaskHandle = osThreadNew(StartEventTask, NULL, &EventTask_attributes);

  /* creation of MonitorTask */
  MonitorTaskHandle = osThreadNew(StartMonitorTask, NULL, &MonitorTask_attributes);

  /* creation of systemEventFlags */
  systemEventFlagsHandle = osEventFlagsNew(&systemEventFlags_attributes);

  /* USER CODE BEGIN RTOS_EVENTS */
  /* add events, ... */
  if ((ControlTaskHandle == NULL) ||
      (DiagnosticTaskHandle == NULL) ||
      (EventTaskHandle == NULL) ||
      (MonitorTaskHandle == NULL) ||
      (statusQueueHandle == NULL) ||
      (systemDataMutexHandle == NULL) ||
      (buttonEventSemaphoreHandle == NULL) ||
      (systemEventFlagsHandle == NULL))
  {
    Error_Handler();
  }
  /* USER CODE END RTOS_EVENTS */

  /* Start scheduler */
  osKernelStart();

  /* We should never get here as control is now taken by the scheduler */

  /* Infinite loop */
  while (1)
  {

  }
}

void SystemClock_Config(void)
{
  RCC_OscInitTypeDef RCC_OscInitStruct = {0};
  RCC_ClkInitTypeDef RCC_ClkInitStruct = {0};

  /** Initializes the RCC Oscillators according to the specified parameters
  * in the RCC_OscInitTypeDef structure.
  */
  RCC_OscInitStruct.OscillatorType = RCC_OSCILLATORTYPE_HSI;
  RCC_OscInitStruct.HSIState = RCC_HSI_ON;
  RCC_OscInitStruct.HSICalibrationValue = RCC_HSICALIBRATION_DEFAULT;
  RCC_OscInitStruct.PLL.PLLState = RCC_PLL_NONE;
  if (HAL_RCC_OscConfig(&RCC_OscInitStruct) != HAL_OK)
  {
    Error_Handler();
  }

  /** Initializes the CPU, AHB and APB buses clocks
  */
  RCC_ClkInitStruct.ClockType = RCC_CLOCKTYPE_HCLK|RCC_CLOCKTYPE_SYSCLK
                              |RCC_CLOCKTYPE_PCLK1|RCC_CLOCKTYPE_PCLK2;
  RCC_ClkInitStruct.SYSCLKSource = RCC_SYSCLKSOURCE_HSI;
  RCC_ClkInitStruct.AHBCLKDivider = RCC_SYSCLK_DIV1;
  RCC_ClkInitStruct.APB1CLKDivider = RCC_HCLK_DIV1;
  RCC_ClkInitStruct.APB2CLKDivider = RCC_HCLK_DIV1;

  if (HAL_RCC_ClockConfig(&RCC_ClkInitStruct, FLASH_LATENCY_0) != HAL_OK)
  {
    Error_Handler();
  }
}

static void MX_GPIO_Init(void)
{
  GPIO_InitTypeDef GPIO_InitStruct = {0};

  /* GPIO Ports Clock Enable */
  __HAL_RCC_GPIOA_CLK_ENABLE();

  /*Configure GPIO pin : BUTTON_INT_Pin */
  GPIO_InitStruct.Pin = BUTTON_INT_Pin;
  GPIO_InitStruct.Mode = GPIO_MODE_IT_RISING;
  GPIO_InitStruct.Pull = GPIO_PULLDOWN;
  HAL_GPIO_Init(BUTTON_INT_GPIO_Port, &GPIO_InitStruct);

  /* EXTI interrupt init*/
  HAL_NVIC_SetPriority(EXTI0_IRQn, 5, 0);
  HAL_NVIC_EnableIRQ(EXTI0_IRQn);

}

/* USER CODE BEGIN 4 */
void HAL_GPIO_EXTI_Callback(uint16_t GPIO_Pin)
{
  if ((GPIO_Pin == BUTTON_INT_Pin) &&
      (buttonEventSemaphoreHandle != NULL))
  {
    button_isr_count++;

    if (osSemaphoreRelease(buttonEventSemaphoreHandle) != osOK)
    {
      button_semaphore_release_error_count++;
    }
  }
}

/* USER CODE END 4 */

void StartControlTask(void *argument)
{
  /* USER CODE BEGIN 5 */
  uint32_t next_wake_tick = osKernelGetTickCount();
  uint32_t status_message = 0U;

  (void)argument;

  for (;;)
  {
    control_task_run_count++;
    status_message++;
    if (osMessageQueuePut(statusQueueHandle,
                          &status_message,
                          0U,
                          0U) == osOK)
    {
      if (osMutexAcquire(systemDataMutexHandle, 1U) == osOK)
      {
        system_data.produced_count++;
        system_data.total_access_count++;

        (void)osMutexRelease(systemDataMutexHandle);
      }
      else
      {
        control_mutex_timeout_count++;
      }

    }
    else
    {
      queue_send_error_count++;
    }

    (void)osEventFlagsSet(systemEventFlagsHandle,
                          EVENT_CONTROL_CYCLE_DONE);
    next_wake_tick += CONTROL_TASK_PERIOD_TICKS;
    (void)osDelayUntil(next_wake_tick);
  }
  /* USER CODE END 5 */
}

void StartDiagnosticTask(void *argument)
{
  /* USER CODE BEGIN StartDiagnosticTask */
	uint32_t next_wake_tick = osKernelGetTickCount();
	uint32_t received_status = 0U;

	(void)argument;

	for (;;)
	{
	  diagnostic_task_run_count++;

	while (osMessageQueueGet(statusQueueHandle,
	                           &received_status,
	                           NULL,
	                           0U) == osOK)
	  {
		if (osMutexAcquire(systemDataMutexHandle, 1U) == osOK)
		  {
		    system_data.consumed_count++;
		    system_data.last_status = received_status;
		    system_data.total_access_count++;

		    (void)osMutexRelease(systemDataMutexHandle);
		  }
		  else
		  {
		    diagnostic_mutex_timeout_count++;
		  }
	    diagnostic_last_status = received_status;
	    diagnostic_message_count++;
	  }
	  (void)osEventFlagsSet(systemEventFlagsHandle,
	                      EVENT_DIAGNOSTIC_CYCLE_DONE);
	  next_wake_tick += DIAGNOSTIC_TASK_PERIOD_TICKS;
	  (void)osDelayUntil(next_wake_tick);
	}
  /* USER CODE END StartDiagnosticTask */
}

void StartEventTask(void *argument)
{
  /* USER CODE BEGIN StartEventTask */
  /* Infinite loop */
  (void)argument;
  for(;;)
  {
    if (osSemaphoreAcquire(buttonEventSemaphoreHandle,osWaitForever) == osOK){
    	if (osTimerStart(buttonDebounceTimerHandle,
    	                 BUTTON_DEBOUNCE_TICKS) != osOK)
    	{
    	  button_timer_start_error_count++;
    	}
    }
  }
  /* USER CODE END StartEventTask */
}

void StartMonitorTask(void *argument)
{
  /* USER CODE BEGIN StartMonitorTask */
  uint32_t received_flags = 0U;
  (void)argument;
  /* Infinite loop */
  for(;;)
  {
	  received_flags =
	          osEventFlagsWait(systemEventFlagsHandle,
	                           EVENT_ALL_CYCLES_DONE,
	                           osFlagsWaitAll,
							   MONITOR_TIMEOUT_TICKS);
	  control_stack_min_free_bytes =
	      osThreadGetStackSpace(ControlTaskHandle);

	  diagnostic_stack_min_free_bytes =
	      osThreadGetStackSpace(DiagnosticTaskHandle);

	  event_stack_min_free_bytes =
	      osThreadGetStackSpace(EventTaskHandle);

	  monitor_stack_min_free_bytes =
	      osThreadGetStackSpace(MonitorTaskHandle);

	  if ((received_flags & osFlagsError) == 0U)
	  {
		 if (TaskSupervisor_ProcessWindow(
		          &task_supervisor,
		          TASK_SUPERVISOR_WINDOW_COMPLETE) !=
		      TASK_SUPERVISOR_OK)
		  {
		    Error_Handler();
		  }
	    //monitor_sync_count++;
	    //task_watchdog_fault_active = 0U;
		 uint8_t refresh_allowed =
		     WatchdogPolicy_IsRefreshAllowed(
		         task_supervisor.state);

		 if (WatchdogService_Execute(
		         refresh_allowed,
		         WatchdogRefresh_Request,
		         &watchdog_request_context) !=
		     WATCHDOG_SERVICE_OK)
		 {
		   Error_Handler();
		 }
	  }
	  else
	  {
	    monitor_wait_error_count++;
	    task_watchdog_last_error = received_flags;

	    if (received_flags == osFlagsErrorTimeout)
	    {
	      //task_watchdog_timeout_count++;
	      //task_watchdog_fault_active = 1U;

	      if (TaskSupervisor_ProcessWindow(
	              &task_supervisor,
	              TASK_SUPERVISOR_WINDOW_TIMEOUT) !=
	          TASK_SUPERVISOR_OK)
	      {
	        Error_Handler();
	      }

	      (void)osEventFlagsClear(systemEventFlagsHandle,
	                              EVENT_ALL_CYCLES_DONE);
	    }
	  }
  }
  /* USER CODE END StartMonitorTask */
}

/* ButtonDebounceTimerCallback function */
void ButtonDebounceTimerCallback(void *argument)
{
  /* USER CODE BEGIN ButtonDebounceTimerCallback */
	(void)argument;

	if (HAL_GPIO_ReadPin(BUTTON_INT_GPIO_Port,
	                     BUTTON_INT_Pin) == GPIO_PIN_SET)
	{
	  button_debounced_count++;
	}
	else
	{
	  button_bounce_rejected_count++;
	}
  /* USER CODE END ButtonDebounceTimerCallback */
}

void HAL_TIM_PeriodElapsedCallback(TIM_HandleTypeDef *htim)
{
  if (htim->Instance == TIM2)
  {
    HAL_IncTick();
  }
}

void Error_Handler(void)
{
  __disable_irq();
  while (1)
  {
  }
}
#ifdef USE_FULL_ASSERT
/**
  * @brief  Reports the name of the source file and the source line number
  *         where the assert_param error has occurred.
  * @param  file: pointer to the source file name
  * @param  line: assert_param error line source number
  * @retval None
  */
void assert_failed(uint8_t *file, uint32_t line)
{
  /* USER CODE BEGIN 6 */
  (void)file;
  (void)line;
  /* USER CODE END 6 */
}
#endif /* USE_FULL_ASSERT */

// file: Core/Src/freertos.c
/* USER CODE BEGIN Header */
/**
  ******************************************************************************
  * File Name          : freertos.c
  * Description        : Code for freertos applications
  ******************************************************************************
  * @attention
  *
  * Copyright (c) 2026 STMicroelectronics.
  * All rights reserved.
  *
  * This software is licensed under terms that can be found in the LICENSE file
  * in the root directory of this software component.
  * If no LICENSE file comes with this software, it is provided AS-IS.
  *
  ******************************************************************************
  */
/* USER CODE END Header */

#include "FreeRTOS.h"
#include "task.h"
#include "main.h"

/* USER CODE BEGIN Variables */
static volatile uint32_t stack_overflow_detected = 0U;
static volatile uint32_t malloc_failed_detected = 0U;
/* USER CODE END Variables */

/* Hook prototypes */
void vApplicationStackOverflowHook(xTaskHandle xTask, signed char *pcTaskName);
void vApplicationMallocFailedHook(void);

/* USER CODE BEGIN 4 */
void vApplicationStackOverflowHook(xTaskHandle xTask,
                                   signed char *pcTaskName)
{
  (void)xTask;
  (void)pcTaskName;

  stack_overflow_detected = 1U;
  Error_Handler();
}
/* USER CODE END 4 */

/* USER CODE BEGIN 5 */
void vApplicationMallocFailedHook(void)
{
  malloc_failed_detected = 1U;
  Error_Handler();
}
/* USER CODE END 5 */
